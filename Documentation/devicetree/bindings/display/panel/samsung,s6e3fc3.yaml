## Documentation/devicetree/bindings/display/panel/samsung,s6e3fc3.yaml
```yaml
# SPDX-License-Identifier: GPL-2.0-only OR BSD-2-Clause
%YAML 1.2
---
$id: http://devicetree.org/schemas/display/panel/samsung,s6e3fc3.yaml#
$schema: http://devicetree.org/meta-schemas/core.yaml#

title: Samsung S6E3FC3 Display Driver IC AMOLED DSI panels

maintainers:
  - AngeloGioacchino Del Regno <angelogioacchino.delregno@collabora.com>

allOf:
  - $ref: panel-common.yaml#

properties:
  compatible:
    items:
      - enum:
          - samsung,ams643ye05
          - samsung,ams646yd04
          - samsung,ams667ym01
      - const: samsung,s6e3fc3

  reg:
    maxItems: 1

  reset-gpios: true

  port: true

  vddio-supply:
    description: VDDIO regulator

  vci-supply:
    description: VCI regulator

required:
  - compatible
  - reset-gpios
  - vddio-supply
  - vci-supply

unevaluatedProperties: false

examples:
  - |
    #include <dt-bindings/gpio/gpio.h>

    dsi {
        #address-cells = <1>;
        #size-cells = <0>;

        panel@0 {
            compatible = "samsung,ams643ye05", "samsung,s6e3fc3";
            reg = <0>;
            vddio-supply = <&mt6362_vmc_ldo_reg>;
            vci-supply = <&mt6362_vfp_ldo_reg>;
            reset-gpios = <&pio 42 GPIO_ACTIVE_HIGH>;
            pinctrl-0 = <&panel_default_pins>;
            pinctrl-names = "default";

            port {
                panel_in: endpoint {
                    remote-endpoint = <&mdss_dsi0_out>;
                };
            };
        };
    };

...
```

## drivers/media/platform/arm/linlon/Kconfig
```kconfig
config VIDEO_LINLON
	tristate "Linlon VPU support"
	depends on VIDEO_DEV && V4L_PLATFORM_DRIVERS
	help
	  This enables support for the Linlon VPU family.

config VIDEO_LINLON_FTRACE
	bool "Send kernel space logs to ftrace"
	depends on VIDEO_LINLON
	default n
	help
	  Send kernel space logs to ftrace.

config VIDEO_LINLON_PRINT_FILE
	bool "Append file and line number to kernel space log messages"
	depends on VIDEO_LINLON
	default y
	help
	  Append file and line number to kernel space log messages.

config VIDEO_LINLON_ANDROID_KERNEL
	bool "Build Linlon VPU driver for Android kernel"
	depends on VIDEO_LINLON
	default n
	help
	  Enable Android-kernel-specific code paths in the Linlon VPU driver.

	  Say N unless you are building for an Android kernel.
```

## drivers/misc/armchina-npu/Kconfig
```kconfig
# SPDX-License-Identifier: GPL-2.0-only
#
# ArmChina Zhouyi NPU driver
#

config ARMCHINA_NPU
	tristate "ArmChina Zhouyi NPU"
	help
	  Say Y or M if you are using any Zhouyi NPU.

	  For other cases, say N.

config ARMCHINA_NPU_ARCH_V1
	bool "ArmChina NPU architecture: v1"
	depends on ARMCHINA_NPU
	help
	  Say Y if the NPU version on your SoC is Zhouyi V1.

	  For other architecture versions, say N.

config ARMCHINA_NPU_ARCH_V2
	bool "ArmChina NPU architecture: v2"
	depends on ARMCHINA_NPU
	help
	  Say Y if the NPU version on your SoC is Zhouyi V2 (i.e. Z2/Z3/X1).

	  For other architecture versions, say N.

config ARMCHINA_NPU_ARCH_V3
	bool "ArmChina NPU architecture: v3"
	depends on ARMCHINA_NPU
	help
	  Say Y if the NPU version on your SoC is Zhouyi V3.

	  For other architecture versions, say N.

config ARMCHINA_NPU_ARCH_V3_2
	bool "ArmChina NPU architecture: v3_2"
	depends on ARMCHINA_NPU
	help
	  Say Y if the NPU version on your SoC is Zhouyi V3_2.

	  For other architecture versions, say N.

config ARMCHINA_NPU_SOC_DEFAULT
	bool "Default SoC APIs"
	depends on ARMCHINA_NPU
	help
	  Say Y if you use the default SoC API implementations provided by ArmChina.

	  For other SoCs, say N.

config ARMCHINA_NPU_SOC_R329
	bool "R329 SoC APIs"
	depends on ARMCHINA_NPU
	help
	  Say Y if you use the Allwinner R329 SoC API implementations.

	  For other SoCs, say N.

config ARMCHINA_NPU_SOC_SKY1
	bool "SKY1 SoC APIs"
	depends on ARMCHINA_NPU
	help
	  Say Y if you use the CIX SKY1 SoC API implementations.

	  For other SoCs, say N.

config CIX_SCMI_EXT
	bool
	help
	  Selected by platform drivers that provide the CIX vendor SCMI
	  extensions (scmi_device_get_freq, scmi_device_set_freq,
	  scmi_device_opp_table_parse).

config ENABLE_DEVFREQ
	bool "Enable devfreq support for ArmChina NPU"
	depends on ARMCHINA_NPU && PM_DEVFREQ && CIX_SCMI_EXT
	help
	  Say Y to enable dynamic voltage and frequency scaling (devfreq)
	  support for the ArmChina Zhouyi NPU.

	  If unsure, say N.
```
