// SPDX-License-Identifier: (GPL-2.0 OR MIT)
/*
 * Mediatek Genio 350-EVK HDMI overlay
 * Copyright (C) 2025 Collabora Ltd.
 */

/dts-v1/;
/plugin/;

/*
 * Ethernet and HDMI (DPI0) are sharing pins.
 * Only one can be enabled at a time and require the physical switch
 * SW2101 to be set on HDMI position
 */

&ethernet {
    status = "disabled";
};

&dpi0 {
    status = "okay";
};

&it66121_hdmi {
    status = "okay";
};
